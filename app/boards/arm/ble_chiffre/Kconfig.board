## app/boards/arm/ble_chiffre/Kconfig.board
```kconfig
# Copyright (c) 2020 The ZMK Contributors
# SPDX-License-Identifier: MIT

config BOARD_BLE_CHIFFRE
   bool "BLe Chiffre"
```

## app/boards/arm/ble_chiffre/Kconfig.defconfig
```kconfig
# Copyright (c) 2020 Pete Johanson, TJ Campie
# SPDX-License-Identifier: MIT

if BOARD_BLE_CHIFFRE

config ZMK_KEYBOARD_NAME
	default "BLe Chiffre"

if USB

config USB_NRFX
	default y

config USB_DEVICE_STACK
	default y

endif # USB

config BT_CTLR
	default BT

config ZMK_BLE
	default y

config ZMK_USB
	default y

config ZMK_BATTERY_VOLTAGE_DIVIDER
	default n

endif # BOARD_BLE_CHIFFRE
```

## app/boards/arm/ble_chiffre/Kconfig.shield
```kconfig
# Copyright (c) 2020 The ZMK Contributors
# SPDX-License-Identifier: MIT

config SHIELD_BLE_CHIFFRE
   def_bool $(shields_list_contains,ble_chiffre)
```
